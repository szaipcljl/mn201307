## linux/sprd_v3_10/kernel/drivers/input/IRDA/Kconfig
```kconfig
#
# IRDA MC96FR116R configuration
#


config IRDA_MC96FR116R
	tristate "IRDA_MC96FR116R"
	help
	  Say Y here if you have a IRDA MC96FR116R and want to enable
	  support for the built-in touchscreen.

	  If unsure, say N.

	  To compile this driver as a module, choose M here: the
	  module will be called hall MC96FR116R.
```

## linux/x86/ivi/bxt_v4.4.19/kernel/bxt/drivers/dma_test/Kconfig
```kconfig
config DMA_TEST
	tristate "dma access mem test"
	default n
	help
	This is the dma access mem test driver.
```

## training/08_driver/sample/test_driver/Kconfig
```kconfig
#
# Test module configuration
#


config TEST_MODULE
	tristate "test module"
	default n
	help
	  This is the test module driver.
```
