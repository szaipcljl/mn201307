/*480*854*/
focaltech_ts@38{
	compatible = "focaltech,focaltech_ts";
	reg = <0x38>;
	gpios = <&d_gpio_gpio 71 0   /*reset_gpio_number*/
		&d_gpio_gpio 72 0>;    /*irq_gpio_number*/
	vdd_name = "vdd28";
	virtualkeys = <80 900 60 60    /*menu*/
		240 900 60 60      /*home page*/
		400 900 60 60>;    /*back*/
	TP_MAX_X = <480>;
	TP_MAX_Y = <854>;
};

/*720*1280*/
focaltech_ts@38{
	compatible = "focaltech,focaltech_ts";
	reg = <0x38>;
	gpios = <&d_gpio_gpio 156 0    /*reset_gpio_number*/
		&d_gpio_gpio 144 0>;     /*irq_gpio_number*/
	vdd_name = "vdd28";
	virtualkeys = <600 1350 60 45    /*menu*/
		360 1350 60 45    /*home page*/ 
		120 1350 60 45>;  /*back*/
	TP_MAX_X = <720>;
	TP_MAX_Y = <1280>;
};

